/*
 * Copyright (c) 2019 hackin zhao
 *
 * SPDX-License-Identifier: Apache-2.0
 */

#include <mem.h>
#include <ti/tm4c123xx.dtsi>

/ {
	sram0: memory@20000000 {
		reg = <0x20000000 DT_SIZE_K(32)>;
	};

	flash0: serial-flash@0 {
		reg = <0x0 DT_SIZE_K(256)>;
	};
};
