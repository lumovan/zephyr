## boards/arm/devkit1207_f207ig/Kconfig.board
```kconfig
# Kconfig - DevKit1207 F207IG board configuration
#
# Copyright (c) 2018 hackin Zhao
#
# SPDX-License-Identifier: Apache-2.0
#

config BOARD_DEVKIT1207_F207IG
	bool "DevKit1207 F207IG Development Board"
	depends on SOC_STM32F207XG
	select HAS_DTS_SPI_DEVICE
	select HAS_DTS_SPI_PINS
	select HAS_DTS_GPIO_DEVICE
```

## boards/arm/devkit1207_f207ig/Kconfig.defconfig
```kconfig
# Kconfig - DevKit1207 F207IG board configuration
#
# Copyright (c) 2018 hackin Zhao
#
# SPDX-License-Identifier: Apache-2.0
#

if BOARD_DEVKIT1207_F207IG

config BOARD
	default "devkit1207_f207ig"

if UART_CONSOLE

config UART_STM32_PORT_3
	default y

endif # UART_CONSOLE

endif # BOARD_DEVKIT1207_F207IG
```

## boards/arm/devkit1207_f207ig/devkit1207_f207ig_defconfig
```kconfig
CONFIG_ARM=y
CONFIG_BOARD_DEVKIT1207_F207IG=y
CONFIG_SOC_SERIES_STM32F2X=y
CONFIG_SOC_STM32F207XG=y
CONFIG_SYS_CLOCK_HW_CYCLES_PER_SEC=120000000
CONFIG_SYS_CLOCK_TICKS_PER_SEC=1000

CONFIG_SERIAL=y

# console
CONFIG_CONSOLE=y
CONFIG_UART_CONSOLE=y
CONFIG_PRINTK=y

# enable pinmux
CONFIG_PINMUX=y

# enable GPIO
CONFIG_GPIO=y

# enable SPI_1
CONFIG_SPI=y
CONFIG_SPI_1=y

# clock configuration
CONFIG_CLOCK_CONTROL=y

# Clock configuration for Cube Clock control driver
CONFIG_CLOCK_STM32_SYSCLK_SRC_PLL=y
# use HSI as PLL input
CONFIG_CLOCK_STM32_PLL_SRC_HSI=y

# produce 120MHz clock at PLL output
CONFIG_CLOCK_STM32_PLL_M_DIVISOR=16
CONFIG_CLOCK_STM32_PLL_N_MULTIPLIER=240
CONFIG_CLOCK_STM32_PLL_P_DIVISOR=2
CONFIG_CLOCK_STM32_PLL_Q_DIVISOR=4
CONFIG_CLOCK_STM32_AHB_PRESCALER=1
CONFIG_CLOCK_STM32_APB1_PRESCALER=4
CONFIG_CLOCK_STM32_APB2_PRESCALER=2

# enable dw1000 driver
CONFIG_IEEE802154_DW1000=y

#enable log level
CONFIG_SYS_LOG_NET_LEVEL=1
#CONFIG_SYS_LOG_SHOW_COLOR=y
CONFIG_NET_LOG=y
#CONFIG_NET_DEBUG_IPV6=y
#CONFIG_NET_DEBUG_L2_IEEE802154=y
CONFIG_SYS_LOG_IEEE802154_DRIVER_LEVEL=4
CONFIG_SYS_LOG_SPI_LEVEL=4

#enable shell
CONFIG_NET_SHELL=y
CONFIG_NET_L2_IEEE802154_SHELL=y

CONFIG_NETWORKING=y
CONFIG_NET_BUF=y
CONFIG_NET_IPV6=y
CONFIG_NET_L2_IEEE802154=y
CONFIG_NET_L2_IEEE802154_SECURITY=y
CONFIG_NET_L2_IEEE802154_ACK_REPLY=y
CONFIG_MAIN_STACK_SIZE=2048
CONFIG_NET_PKT_RX_COUNT=5
CONFIG_NET_PKT_TX_COUNT=5
CONFIG_NET_BUF_RX_COUNT=10
CONFIG_NET_BUF_TX_COUNT=10
CONFIG_ENTROPY_GENERATOR=y
CONFIG_TEST_RANDOM_GENERATOR=y
```

## boards/arm/ti_tm4c123gxl_launchpad/ti_tm4c123gxl_launchpad_defconfig
```kconfig
CONFIG_ARM=y
CONFIG_BOARD_TI_TM4C123GXL_LAUNCHPAD=y
CONFIG_SOC_FAMILY_TIVAWARE=y
CONFIG_SOC_SERIES_TM4C123=y
CONFIG_SOC_TM4C123GH6PM=y
CONFIG_CORTEX_M_SYSTICK=y
CONFIG_FLASH=y

# Enable TI TIVAWARE SDK
CONFIG_HAS_TIVAWARE_SDK=y

#enable GPIO driver
CONFIG_GPIO=y
CONFIG_GPIO_TM4C123=y
CONFIG_GPIO_TM4C123_PORTA=y
CONFIG_GPIO_TM4C123_PORTB=y
CONFIG_GPIO_TM4C123_PORTE=y
CONFIG_GPIO_TM4C123_PORTF=y

# enable uart driver
CONFIG_SERIAL=y
CONFIG_SERIAL_HAS_DRIVER=y
CONFIG_UART_TM4C123=y
CONFIG_UART_INTERRUPT_DRIVEN=y

# enable console
CONFIG_CONSOLE=y
CONFIG_UART_CONSOLE=y
CONFIG_PRINTK=y

#enable log level
#CONFIG_NET_LOG=y
#CONFIG_SYS_LOG_IEEE802154_DRIVER_LEVEL=4

# enable ieee802154
# CONFIG_IEEE802154_DW1000=y

# enable uart driver
CONFIG_SERIAL=y
CONFIG_SERIAL_HAS_DRIVER=y
CONFIG_UART_TM4C123=y
CONFIG_UART_INTERRUPT_DRIVEN=y

#enable spi driver
#CONFIG_SPI_TM4C123=y
#CONFIG_SPI_0=y
#CONFIG_SPI=y
#CONFIG_SPI_TM4C123_INTERRUPT=y
#CONFIG_SPI_ASYNC=y

#enable shell
#CONFIG_NET_SHELL=y
#CONFIG_NET_L2_IEEE802154_SHELL=y
#
#CONFIG_NETWORKING=y
#CONFIG_NET_BUF=y
#CONFIG_NET_IPV6=y
#CONFIG_NET_L2_IEEE802154=y
#CONFIG_NET_L2_IEEE802154_SECURITY=y
#CONFIG_NET_L2_IEEE802154_ACK_REPLY=y
#CONFIG_MAIN_STACK_SIZE=2048
#CONFIG_NET_PKT_RX_COUNT=5
#CONFIG_NET_PKT_TX_COUNT=5
#CONFIG_NET_BUF_RX_COUNT=10
#CONFIG_NET_BUF_TX_COUNT=10
#CONFIG_ENTROPY_GENERATOR=y
#CONFIG_TEST_RANDOM_GENERATOR=y
```

## drivers/gpio/Kconfig.tm4c123
```kconfig
# Kconfig.tm4c123- TM4C123 GPIO configuration options
#

menuconfig GPIO_TM4C123
	bool "TI TM4C123 GPIO driver"
	depends on GPIO && SOC_FAMILY_TIVAWARE
	default n
	help
	  Enable the GPIO driver on TI TivaWare TM4C123 boards

if GPIO_TM4C123

config GPIO_TM4C123_PORTA
	bool "GPIO block A"
	depends on GPIO_TM4C123
	default n
	help
	  Include support for the GPIO port A.

config TM4C123_GPIOA_NAME
	string "Driver name"
	depends on GPIO_TM4C123_PORTA
	default "GPIOA"

config TM4C123_GPIOA_IRQ_PRI
	int "GPIOA interrupt priority"
	depends on GPIO_TM4C123_PORTA
	range 0 5
	default 1
	help
	  TM4C123 GPIOA IRQ priority.

config GPIO_TM4C123_PORTB
	bool "GPIO block B"
	depends on GPIO_TM4C123
	default n
	help
	  Include support for the GPIO port B.

config TM4C123_GPIOB_NAME
	string "Driver name"
	depends on GPIO_TM4C123_PORTB
	default "GPIOB"

config TM4C123_GPIOB_IRQ_PRI
	int "GPIOB interrupt priority"
	depends on GPIO_TM4C123_PORTB
	range 0 5
	default 1
	help
	  TM4C123 GPIOB IRQ priority.

config GPIO_TM4C123_PORTC
	bool "GPIO block A"
	depends on GPIO_TM4C123
	default n
	help
	  Include support for the GPIO port C.

config TM4C123_GPIOC_NAME
	string "Driver name"
	depends on GPIO_TM4C123_PORTC
	default "GPIOC"

config TM4C123_GPIOC_IRQ_PRI
	int "GPIOA interrupt priority"
	depends on GPIO_TM4C123_PORTC
	range 0 5
	default 1
	help
	  TM4C123 GPIOC IRQ priority.

config GPIO_TM4C123_PORTD
	bool "GPIO block D"
	depends on GPIO_TM4C123
	default n
	help
	  Include support for the GPIO port D.

config TM4C123_GPIOD_NAME
	string "Driver name"
	depends on GPIO_TM4C123_PORTD
	default "GPIOD"

config TM4C123_GPIOD_IRQ_PRI
	int "GPIOD interrupt priority"
	depends on GPIO_TM4C123_PORTD
	range 0 5
	default 1
	help
	  TM4C123 GPIOD IRQ priority.

config GPIO_TM4C123_PORTE
	bool "GPIO block E"
	depends on GPIO_TM4C123
	default n
	help
	  Include support for the GPIO port E.

config TM4C123_GPIOE_NAME
	string "Driver name"
	depends on GPIO_TM4C123_PORTE
	default "GPIOE"

config TM4C123_GPIOE_IRQ_PRI
	int "GPIOA interrupt priority"
	depends on GPIO_TM4C123_PORTE
	range 0 5
	default 1
	help
	  TM4C123 GPIOE IRQ priority.

config GPIO_TM4C123_PORTF
	bool "GPIO block F"
	depends on GPIO_TM4C123
	default n
	help
	  Include support for the GPIO port F.

config TM4C123_GPIOF_NAME
	string "Driver name"
	depends on GPIO_TM4C123_PORTF
	default "GPIOF"

config TM4C123_GPIOF_IRQ_PRI
	int "GPIOA interrupt priority"
	depends on GPIO_TM4C123_PORTF
	range 0 5
	default 1
	help
	  TM4C123 GPIOF IRQ priority.

config GPIO_TM4C123_PORTG
	bool "GPIO block G"
	depends on GPIO_TM4C123
	default n
	help
	  Include support for the GPIO port G.

config TM4C123_GPIOG_NAME
	string "Driver name"
	depends on GPIO_TM4C123_PORTG
	default "GPIOG"

config TM4C123_GPIOG_IRQ_PRI
	int "GPIOA interrupt priority"
	depends on GPIO_TM4C123_PORTG
	range 0 5
	default 1
	help
	  TM4C123 GPIOG IRQ priority.

config GPIO_TM4C123_PORTH
	bool "GPIO block H"
	depends on GPIO_TM4C123
	default n
	help
	  Include support for the GPIO port H.

config TM4C123_GPIOH_NAME
	string "Driver name"
	depends on GPIO_TM4C123_PORTH
	default "GPIOH"

config TM4C123_GPIOH_IRQ_PRI
	int "GPIOA interrupt priority"
	depends on GPIO_TM4C123_PORTH
	range 0 5
	default 1
	help
	  TM4C123 GPIOH IRQ priority.

endif # GPIO_TM4C123
```

## dts/bindings/gpio/ti,tm4c123-gpio.yaml
```yaml
---
title: tm4c123 GPIO
id: ti,tm4c123-gpio
version: 0.1

description: >
    This is a representation of the tm4c123xx GPIO nodes

properties:
    compatible:
      type: string
      category: required
      description: compatible strings
      constraint: "ti,tm4c123-gpio"

    reg:
      type: int
      description: mmio register space
      generation: define
      category: required

    interrupts:
      type: compound
      category: required
      description: required interrupts
      generation: define

    label:
      type: string
      category: required
      description: Human readable string describing the device (used by Zephyr for API name)
      generation: define

"#cells":
  - pin
  - flags
...
```

## dts/bindings/ieee802154/decawave,dw1000.yaml
```yaml
#
# Copyright (c) 2018, hackin, zhao
#
# SPDX-License-Identifier: Apache-2.0
#
---
title: decawave dw1000 802.15.4 indoor position Wireless Transceiver
id: decawave,dw1000
version: 0.1

description: >
    This is a representation of the decawave dw1000 wireless transceiver.

inherits:
    !include spi-device.yaml

properties:
    compatible:
      constraint: "decawave,dw1000"

    irq-gpios:
      type: compound
      category: required
      generation: define, use-prop-name

    reset-gpios:
      type: compound
      category: required
      generation: define, use-prop-name

    wakeup-gpios:
      type: compound
      category: required
      generation: define, use-prop-name
...
```

## soc/arm/ti_tivaware/Kconfig
```kconfig
# Kconfig - Texas Instruments Tivaware Family
#

config SOC_FAMILY_TIVAWARE
	bool
	# omit prompt to signify a "hidden" option
	default n

if SOC_FAMILY_TIVAWARE
config SOC_FAMILY
	string
	default "ti_tivaware"
endif

source "soc/arm/ti_tivaware/*/Kconfig.soc"
```

## soc/arm/ti_tivaware/Kconfig.soc
```kconfig
# Kconfig - Texas Instruments Tivaware Family
#

source "soc/arm/ti_tivaware/*/Kconfig.series"
```

## soc/arm/ti_tivaware/tm4c123/Kconfig.defconfig.series
```kconfig
# Kconfig.defconfig.series - TI tivaware Family
#

if SOC_SERIES_TM4C123

source "soc/arm/ti_tivaware/tm4c123/Kconfig.defconfig.tm4c123*"

config SOC_SERIES
	default "tm4c123"

endif # SOC_SERIES_TM4C123
```

## soc/arm/ti_tivaware/tm4c123/Kconfig.defconfig.tm4c123gh6pm
```kconfig
# Kconfig.defconfig.tm4c123gh6pm - TI tm4c12x TM4C123gxl SoC
#

if SOC_TM4C123GH6PM

config SOC
	string
	default "tm4c123gh6pm"

config NUM_IRQS
	int
	# must be >= the highest interrupt number used
	# This includes the NWP interrupt
	default 154

config SYS_CLOCK_HW_CYCLES_PER_SEC
	int
	default 80000000

# if GPIO
#
# config GPIO_TM4C123GH6PM
# 	def_bool y
#
# config GPIO_GPIO_TM4C123GXL_A0
# 	default n
#
# config GPIO_GPIO_TM4C123GXL_A1
# 	default y
#
# config GPIO_GPIO_TM4C123GXL_A2
# 	default y
#
# config GPIO_GPIO_TM4C123GXL_A3
# 	default n
#
# endif # GPIO

if NETWORKING

if !NET_L2_OPENTHREAD
config NET_L2_IEEE802154
	def_bool y
endif # NET_L2_OPENTHREAD

config IEEE802154_DW1000
	def_bool y

config NET_CONFIG_IEEE802154_DEV_NAME
	default IEEE802154_DW1000_DRV_NAME

endif # NETWORKING

endif # SOC_TM4C123GH6PM
```
